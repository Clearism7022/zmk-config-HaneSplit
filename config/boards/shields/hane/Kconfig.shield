## config/boards/shields/hane/Kconfig.shield
```kconfig
# Copyright (c) 2022 The ZMK Contributors
# SPDX-License-Identifier: MIT

config SHIELD_HANE_LEFT
    def_bool $(shields_list_contains,hane_left)

config SHIELD_HANE_RIGHT
    def_bool $(shields_list_contains,hane_right)
```
